## electric_guitar/Kconfig
```kconfig
#
# For a description of the syntax of this configuration file,
# see the file kconfig-language.txt in the NuttX tools repository.
#

config EXAMPLES_SIXAXIS_2
	bool "electric_guitar"
	default y
	---help---
		Enable the 6 axis sensor example

if EXAMPLES_SIXAXIS_2

config EXAMPLES_SIXAXIS_PROGNAME_2
	string "Program name"
	default "electric_guitar"
	---help---
		This is the name of the program that will be use when the NSH ELF
		program is installed.

config EXAMPLES_SIXAXIS_PRIORITY_2
	int "electric_guitar task priority"
	default 100

config EXAMPLES_SIXAXIS_STACKSIZE_2
	int "electric_guitar stack size"
	default DEFAULT_TASK_STACKSIZE

endif
```

## musical_chairs/Kconfig
```kconfig
#
# For a description of the syntax of this configuration file,
# see the file kconfig-language.txt in the NuttX tools repository.
#

config EXAMPLES_AUDIO_PLAYER2
	tristate "Audio player example"
	default n
	depends on CXD56_AUDIO
	---help---
		Enable the audio player example

if EXAMPLES_AUDIO_PLAYER2

choice
	prompt "Output device selection"
	default EXAMPLES_AUDIO_PLAYER_OUTPUT_DEV_SPHP2
	---help---
		Set the device type of output to use

config EXAMPLES_AUDIO_PLAYER_OUTPUT_DEV_SPHP2
	bool "Speaker/Headphone output"

config EXAMPLES_AUDIO_PLAYER_OUTPUT_DEV_I2S2
	bool "I2S output"
endchoice

choice
	prompt "player mode selection"
	default EXAMPLES_AUDIO_PLAYER_MODE_NORMAL2
	---help---
		Set the operation mode of player capability.
		To play include Hi-Res file, select Hi-Res mode.
		If it is not Hi-Res file, select Normal mode.

config EXAMPLES_AUDIO_PLAYER_MODE_NORMAL2
	bool "Normal mode"

config EXAMPLES_AUDIO_PLAYER_MODE_HIRES2
	bool "Hi-Res mode"
endchoice

config EXAMPLES_AUDIO_PLAYER_USEPOSTPROC2
    bool "Use Posstprocess"
    default n

config EXAMPLES_AUDIO_PLAYER_PROGNAME2
	string "Program name"
	default "musical_chairs"

config EXAMPLES_AUDIO_PLAYER_PRIORITY2
	int "Audio player task priority"
	default 150

config EXAMPLES_AUDIO_PLAYER_STACKSIZE2
	int "Audio player stack size"
	default 2048
endif
```

## shooting_watch/Kconfig
```kconfig
config SPRESENSE_GAME_SHOOTING_WATCH
	tristate "shooting_watch"
	default y
	---help---
		Enable the shooting_watch app

if SPRESENSE_GAME_SHOOTING_WATCH

config SPRESENSE_GAME_SHOOTING_WATCH_PROGNAME
	string "Program name"
	default "shooting_watch"
	---help---
		This is the name of the program that will be use when the NSH ELF
		program is installed.

config SPRESENSE_GAME_SHOOTING_WATCH_PRIORITY
	int "shooting_watch task priority"
	default 100

config SPRESENSE_GAME_SHOOTING_WATCH_STACKSIZE
	int "shooting_watch stack size"
	default 2048

endif
```
